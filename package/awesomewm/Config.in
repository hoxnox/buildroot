## package/awesomewm/Config.in
```kconfig
config BR2_PACKAGE_AWESOMEWM
	bool "awesomewm"
	select BR2_PACKAGE_LUAJIT
	select BR2_PACKAGE_LIBGLIB2
	select BR2_PACKAGE_GDK_PIXBUF
	select BR2_PACKAGE_CAIRO
	select BR2_PACKAGE_CAIRO_PNG
	select BR2_PACKAGE_CAIRO_PDF
	select BR2_PACKAGE_CAIRO_PS
	select BR2_PACKAGE_CAIRO_SVG
	select BR2_PACKAGE_LIBXCB
	select BR2_PACKAGE_XCB_UTIL_CURSOR
	select BR2_PACKAGE_XCB_UTIL_KEYSYMS
	select BR2_PACKAGE_XCB_UTIL_XRM
	select BR2_PACKAGE_XCB_UTIL_WM
	select BR2_PACKAGE_LIBXKBCOMMON 
	select BR2_PACKAGE_STARTUP_NOTIFICATION
	select BR2_PACKAGE_LIBXDG_BASEDIR
	select BR2_PACKAGE_LUA_LGI
	depends on BR2_PACKAGE_XORG7
	help
	  Awesome windows manager
```

## package/libxdg-basedir/Config.in
```kconfig
config BR2_PACKAGE_LIBXDG_BASEDIR
	bool "libxdg-basedir"
	help
	  Small library to access XDG Base Directories Specification paths

	  http://repo.or.cz/w/libxdg-basedir.git
```

## package/lua-lgi/Config.in
```kconfig
config BR2_PACKAGE_LUA_LGI
	bool "lua-lgi"
    select BR2_PACKAGE_GOBJECT_INTROSPECTION 
	help
	  Dynamic Lua binding to GObject libraries using GObject-Introspection

	  https://github.com/pavouk/lgi
```

## package/ssh-askpass-fullscreen/Config.in
```kconfig
config BR2_PACKAGE_SSH_ASKPASS_FULLSCREEN
	bool "ssh-askpass-fullscreen"
	select BR2_PACKAGE_LIBGTK2
	help
	  A tiny GTK2 ssh askpass replacement.
	
	  https://github.com/atj/ssh-askpass-fullscreen 
```

## package/vicious/Config.in
```kconfig
config BR2_PACKAGE_VICIOUS
	bool "vicious"
	depends on BR2_PACKAGE_AWESOMEWM
	help
	  Vicious is a modular widget library for window managers, but mostly catering to users of the
	  "awesome" window manager.
	
	  https://github.com/Mic92/vicious
```

## package/x11r7/xcb-util-xrm/Config.in
```kconfig
config BR2_PACKAGE_XCB_UTIL_XRM
	bool "xcb-util-xrm"
	select BR2_PACKAGE_LIBXCB
	help
	  X C-language Bindings sample implementations
	
	  https://github.com/Airblader/xcb-util-xrm
```

## package/xkb-switch/Config.in
```kconfig
config BR2_PACKAGE_XKB_SWITCH
	bool "xkb-witch"
	depends on BR2_PACKAGE_XORG7
	help
	  xkb-switch is a C++ program that allows to query and change the XKB layout state.
	
	  https://github.com/ierton/xkb-switch
```
